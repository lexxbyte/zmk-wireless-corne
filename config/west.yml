## config/west.yml
```yaml
manifest:
  remotes:
    - name: zmkfirmware
      url-base: https://github.com/zmkfirmware
    - name: lexxbyte
      url-base: https://github.com/lexxbyte
  projects:
    - name: zmk
      remote: zmkfirmware
      revision: v0.3.0
      import: app/west.yml
    - name: zmk-nice-oled
      remote: lexxbyte
      revision: c7c1e82d7a2befecd64ca57848da9ac66c0d1437
  self:
    path: config
```
